## espidf/components/kxr60/Kconfig
```kconfig
menu "KX-R60 interface"
    config KXR60_ACK_TIMEOUT_MS
        int "Timeout per ACK transition (milliseconds)"
        range 10 5000
        default 500
        help
            Each ACK phase has its own deadline. A timeout releases the lines
            and latches a fault until explicit recovery with kxr60_init().
endmenu
```

## espidf/sdkconfig.defaults
```kconfig
CONFIG_IDF_TARGET="esp32s3"
CONFIG_ESP_CONSOLE_UART_DEFAULT=y
CONFIG_ESP_CONSOLE_UART_BAUDRATE=115200
CONFIG_ESP_CONSOLE_SECONDARY_NONE=y
CONFIG_FREERTOS_HZ=1000
CONFIG_ESP_MAIN_TASK_STACK_SIZE=6144
CONFIG_LOG_DEFAULT_LEVEL_INFO=y
CONFIG_LOG_MAXIMUM_LEVEL_DEBUG=y
```
